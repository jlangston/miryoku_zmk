// Copyright 2021 Manna Harbour
// https://github.com/manna-harbour/miryoku

#include "../miryoku/custom_config.h"
#include "../miryoku/mapping/42/corne.h"
#include "../miryoku/miryoku.dtsi"

// NAV layer = 4, MOUSE layer = 5 in Miryoku
&trackpad_listener {
    status = "okay";
    scroller {
        layers = <4>;
    };
};

// Shield default is &mo 4 (beekeeb's mouse-button layer); Miryoku's is MOUSE = 5
&is_touching_processor {
    bindings = <&mo 5>;
};
